/* MIT License
 *
 * Copyright (c) 2019 - 2026 Andreas Merkle <web@blue-andi.de>
 *
 * Permission is hereby granted, free of charge, to any person obtaining a copy
 * of this software and associated documentation files (the "Software"), to deal
 * in the Software without restriction, including without limitation the rights
 * to use, copy, modify, merge, publish, distribute, sublicense, and/or sell
 * copies of the Software, and to permit persons to whom the Software is
 * furnished to do so, subject to the following conditions:
 *
 * The above copyright notice and this permission notice shall be included in all
 * copies or substantial portions of the Software.
 *
 * THE SOFTWARE IS PROVIDED "AS IS", WITHOUT WARRANTY OF ANY KIND, EXPRESS OR
 * IMPLIED, INCLUDING BUT NOT LIMITED TO THE WARRANTIES OF MERCHANTABILITY,
 * FITNESS FOR A PARTICULAR PURPOSE AND NONINFRINGEMENT. IN NO EVENT SHALL THE
 * AUTHORS OR COPYRIGHT HOLDERS BE LIABLE FOR ANY CLAIM, DAMAGES OR OTHER
 * LIABILITY, WHETHER IN AN ACTION OF CONTRACT, TORT OR OTHERWISE, ARISING FROM,
 * OUT OF OR IN CONNECTION WITH THE SOFTWARE OR THE USE OR OTHER DEALINGS IN THE
 * SOFTWARE.
 */

/*******************************************************************************
    DESCRIPTION
*******************************************************************************/
/**
 * @file   TestPngImgLoader.cpp
 * @brief  Test PNG image loader.
 * @author Andreas Merkle <web@blue-andi.de>
 */

/******************************************************************************
 * Includes
 *****************************************************************************/
#include <unity.h>
#include <stdio.h>
#include <string.h>
#include <FS.h>
#include <PngImgLoader.h>
#include <YAGfxBitmap.h>
#include <Util.h>

/******************************************************************************
 * Compiler Switches
 *****************************************************************************/

/******************************************************************************
 * Macros
 *****************************************************************************/

/******************************************************************************
 * Types and classes
 *****************************************************************************/

/**
 * Description of a PNG file, which is generated by the test itself. Only the
 * chunks which the loader cares about are supported: IHDR, PLTE, tRNS, IDAT
 * and IEND.
 */
struct PngSpec
{
    uint32_t       width;       /**< Image width in pixels. */
    uint32_t       height;      /**< Image height in pixels. */
    uint8_t        bitDepth;    /**< Bits per sample. */
    uint8_t        colorType;   /**< PNG color type. */
    const uint8_t* palette;     /**< Palette (PLTE) colors as RGB triplets. May be nullptr. */
    size_t         paletteSize; /**< Size of the palette in bytes. */
    const uint8_t* trns;        /**< Transparency (tRNS) alpha values. May be nullptr. */
    size_t         trnsSize;    /**< Size of the transparency information in bytes. */
    const uint8_t* raw;         /**< Raw image data, every scanline prefixed by its filter byte. May be nullptr. */
    size_t         rawSize;     /**< Size of the raw image data in bytes. */
};

/******************************************************************************
 * Prototypes
 *****************************************************************************/

static void     testPngImgLoaderStatic();
static void     testPngImgLoaderNotFound();
static void     testPngImgLoaderNotAPng();
static void     testPngImgLoaderUsesGivenFs();
static void     testPngImgLoaderAlpha();
static void     testPngImgLoaderTruncated();
static void     testPngImgLoaderImgTooBig();
static void     testPngImgLoaderPixelTypes();
static void     testPngImgLoaderPackedIndexed();
static void     testPngImgLoaderPackedGrayscale();
static void     testPngImgLoaderSample16Bit();
static void     testPngImgLoaderLineBufferLimit();

static bool     copyFilePart(const char* srcFileName, const char* dstFileName, size_t maxSize);
static bool     getFileSize(const char* fileName, size_t& size);
static bool     writeFile(const char* fileName, const uint8_t* data, size_t size);
static bool     writePngFile(const char* fileName, const PngSpec& spec);
static bool     appendChunk(uint8_t* buffer, size_t bufferSize, size_t& offset, const char* type, const uint8_t* payload, size_t payloadSize);
static bool     appendIdatChunk(uint8_t* buffer, size_t bufferSize, size_t& offset, const uint8_t* raw, size_t rawSize);
static void     writeUInt32Be(uint8_t* buffer, uint32_t value);
static uint32_t calcCrc32(const uint8_t* data, size_t size);
static uint32_t calcAdler32(const uint8_t* data, size_t size);

/******************************************************************************
 * Local Variables
 *****************************************************************************/

/** Static PNG test image, a lossless conversion of test_GifImgPlayer/TestStatic.gif. */
static const char* FILE_NAME_STATIC         = "./test/test_PngImgLoader/TestStatic.png";

/** Root path of a filesystem which is mounted below the test folder. */
static const char* FS_ROOT_PATH             = "./test/test_PngImgLoader";

/** Name of the static PNG test image, relative to FS_ROOT_PATH. */
static const char* FILE_NAME_IN_FS_ROOT     = "/TestStatic.png";

/** Temporary file, which gets a copy of a GIF file with a .png extension. */
static const char* FILE_NAME_NO_PNG         = "./test/test_PngImgLoader/NotAPng.tmp.png";

/** A GIF file, used to verify that a non-PNG file is rejected. */
static const char* FILE_NAME_GIF_SOURCE     = "./test/test_GifImgPlayer/TestStatic.gif";

/** Temporary file, which gets a truncated copy of the static PNG test image. */
static const char* FILE_NAME_TRUNCATED      = "./test/test_PngImgLoader/Truncated.tmp.png";

/** Temporary file, which gets a generated PNG image. */
static const char* FILE_NAME_GENERATED      = "./test/test_PngImgLoader/Generated.tmp.png";

/** Max. size of a PNG file which the test generates, in bytes. */
static const size_t PNG_BUFFER_SIZE         = 4096U;

/** PNG file signature. */
static const uint8_t PNG_SIGNATURE[]        = { 0x89U, 0x50U, 0x4EU, 0x47U, 0x0DU, 0x0AU, 0x1AU, 0x0AU };

/** Size of a chunk length field, type field and CRC field together, in bytes. */
static const size_t PNG_CHUNK_OVERHEAD      = 12U;

/** Size of the IHDR chunk payload in bytes. */
static const size_t PNG_IHDR_PAYLOAD_SIZE   = 13U;

/** PNG color type: grayscale. */
static const uint8_t PNG_COLOR_TYPE_GRAY    = 0U;

/** PNG color type: truecolor. */
static const uint8_t PNG_COLOR_TYPE_RGB     = 2U;

/** PNG color type: indexed. */
static const uint8_t PNG_COLOR_TYPE_INDEXED = 3U;

/** PNG color type: grayscale with alpha channel. */
static const uint8_t PNG_COLOR_TYPE_GRAY_A  = 4U;

/** PNG color type: truecolor with alpha channel. */
static const uint8_t PNG_COLOR_TYPE_RGBA    = 6U;

/** Expected image width of the static test image. */
static const uint16_t EXPECTED_DATA_WIDTH   = 10U;

/** Expected image height of the static test image. */
static const uint16_t EXPECTED_DATA_HEIGHT  = 10U;

/**
 * Expected image data of the static test image.
 * Its the very same array as in test_GifImgPlayer/TestGifImgPlayer.cpp, because
 * the PNG fixture is a lossless conversion of the GIF fixture.
 */
/* clang-format off */
static const uint32_t EXPECTED_DATA[] = {
    /*          0          1          2          3          4          5          6          7          8          9 */
    /* 0 */ 0xFF0000U, 0xFF0000U, 0xFF0000U, 0xFF0000U, 0xFF0000U, 0x0000FFU, 0x0000FFU, 0x0000FFU, 0x0000FFU, 0x0000FFU,
    /* 1 */ 0xFF0000U, 0xFF0000U, 0xFF0000U, 0xFF0000U, 0xFF0000U, 0x0000FFU, 0x0000FFU, 0x0000FFU, 0x0000FFU, 0x0000FFU,
    /* 2 */ 0xFF0000U, 0xFF0000U, 0xFF0000U, 0xFF0000U, 0xFF0000U, 0x0000FFU, 0x0000FFU, 0x0000FFU, 0x0000FFU, 0x0000FFU,
    /* 3 */ 0xFF0000U, 0xFF0000U, 0xFF0000U, 0xFFFFFFU, 0xFFFFFFU, 0xFFFFFFU, 0xFFFFFFU, 0x0000FFU, 0x0000FFU, 0x0000FFU,
    /* 4 */ 0xFF0000U, 0xFF0000U, 0xFF0000U, 0xFFFFFFU, 0xFFFFFFU, 0xFFFFFFU, 0xFFFFFFU, 0x0000FFU, 0x0000FFU, 0x0000FFU,
    /* 5 */ 0x0000FFU, 0x0000FFU, 0x0000FFU, 0xFFFFFFU, 0xFFFFFFU, 0xFFFFFFU, 0xFFFFFFU, 0xFF0000U, 0xFF0000U, 0xFF0000U,
    /* 6 */ 0x0000FFU, 0x0000FFU, 0x0000FFU, 0xFFFFFFU, 0xFFFFFFU, 0xFFFFFFU, 0xFFFFFFU, 0xFF0000U, 0xFF0000U, 0xFF0000U,
    /* 7 */ 0x0000FFU, 0x0000FFU, 0x0000FFU, 0x0000FFU, 0x0000FFU, 0xFF0000U, 0xFF0000U, 0xFF0000U, 0xFF0000U, 0xFF0000U,
    /* 8 */ 0x0000FFU, 0x0000FFU, 0x0000FFU, 0x0000FFU, 0x0000FFU, 0xFF0000U, 0xFF0000U, 0xFF0000U, 0xFF0000U, 0xFF0000U,
    /* 9 */ 0x0000FFU, 0x0000FFU, 0x0000FFU, 0x0000FFU, 0x0000FFU, 0xFF0000U, 0xFF0000U, 0xFF0000U, 0xFF0000U, 0xFF0000U
};
/* clang-format on */

/******************************************************************************
 * Public Methods
 *****************************************************************************/

/******************************************************************************
 * Protected Methods
 *****************************************************************************/

/******************************************************************************
 * Private Methods
 *****************************************************************************/

/******************************************************************************
 * External Functions
 *****************************************************************************/

/**
 * Main entry point
 *
 * @param[in] argc  Number of command line arguments
 * @param[in] argv  Command line arguments
 */
extern int main(int argc, char** argv)
{
    UTIL_NOT_USED(argc);
    UTIL_NOT_USED(argv);

    UNITY_BEGIN();

    RUN_TEST(testPngImgLoaderStatic);
    RUN_TEST(testPngImgLoaderNotFound);
    RUN_TEST(testPngImgLoaderNotAPng);
    RUN_TEST(testPngImgLoaderUsesGivenFs);
    RUN_TEST(testPngImgLoaderAlpha);
    RUN_TEST(testPngImgLoaderTruncated);
    RUN_TEST(testPngImgLoaderImgTooBig);
    RUN_TEST(testPngImgLoaderPixelTypes);
    RUN_TEST(testPngImgLoaderPackedIndexed);
    RUN_TEST(testPngImgLoaderPackedGrayscale);
    RUN_TEST(testPngImgLoaderSample16Bit);
    RUN_TEST(testPngImgLoaderLineBufferLimit);

    return UNITY_END();
}

/**
 * Setup a test. This function will be called before every test by unity.
 */
extern void setUp(void)
{
    /* Not used. */
}

/**
 * Clean up test. This function will be called after every test by unity.
 */
extern void tearDown(void)
{
    /* Not used. */
}

/******************************************************************************
 * Local Functions
 *****************************************************************************/

/**
 * Test the PNG image loader with a static truecolor PNG image.
 */
static void testPngImgLoaderStatic()
{
    PngImgLoader       loader;
    YAGfxDynamicBitmap bitmap;
    FS                 fileSystem;
    uint16_t           x;
    uint16_t           y;

    TEST_ASSERT_EQUAL(PngImgLoader::RET_OK, loader.load(fileSystem, FILE_NAME_STATIC, bitmap));
    TEST_ASSERT_TRUE(bitmap.isAllocated());
    TEST_ASSERT_EQUAL_UINT16(EXPECTED_DATA_WIDTH, bitmap.getWidth());
    TEST_ASSERT_EQUAL_UINT16(EXPECTED_DATA_HEIGHT, bitmap.getHeight());

    for (y = 0U; y < EXPECTED_DATA_HEIGHT; ++y)
    {
        for (x = 0U; x < EXPECTED_DATA_WIDTH; ++x)
        {
            const uint32_t expected = EXPECTED_DATA[x + y * EXPECTED_DATA_WIDTH];
            const uint32_t actual   = static_cast<uint32_t>(bitmap.getColor(static_cast<int16_t>(x), static_cast<int16_t>(y)));

            TEST_ASSERT_EQUAL_UINT32(expected, actual);
        }
    }
}

/**
 * Test the PNG image loader with a file which does not exist.
 */
static void testPngImgLoaderNotFound()
{
    PngImgLoader       loader;
    YAGfxDynamicBitmap bitmap;
    FS                 fileSystem;

    TEST_ASSERT_EQUAL(PngImgLoader::RET_FILE_NOT_FOUND, loader.load(fileSystem, "./test/test_PngImgLoader/DoesNotExist.png", bitmap));
    TEST_ASSERT_FALSE(bitmap.isAllocated());
    TEST_ASSERT_EQUAL_UINT16(0U, bitmap.getWidth());
    TEST_ASSERT_EQUAL_UINT16(0U, bitmap.getHeight());
}

/**
 * Test the PNG image loader with a file which is no PNG file at all. The
 * extension alone must not decide, the content does.
 */
static void testPngImgLoaderNotAPng()
{
    PngImgLoader       loader;
    YAGfxDynamicBitmap bitmap;
    FS                 fileSystem;
    size_t             gifSize = 0U;

    TEST_ASSERT_TRUE(getFileSize(FILE_NAME_GIF_SOURCE, gifSize));
    TEST_ASSERT_TRUE(copyFilePart(FILE_NAME_GIF_SOURCE, FILE_NAME_NO_PNG, gifSize));

    TEST_ASSERT_EQUAL(PngImgLoader::RET_FILE_FORMAT_INVALID, loader.load(fileSystem, FILE_NAME_NO_PNG, bitmap));
    TEST_ASSERT_FALSE(bitmap.isAllocated());
    TEST_ASSERT_EQUAL_UINT16(0U, bitmap.getWidth());
    TEST_ASSERT_EQUAL_UINT16(0U, bitmap.getHeight());

    (void)remove(FILE_NAME_NO_PNG);
}

/**
 * Test that the loader reads through the filesystem which is handed to load()
 * and not through the global FILESYSTEM.
 *
 * The filesystem used here is mounted below the test folder, so the very same
 * file name resolves to nothing at all in the global filesystem, which is
 * mounted in the current working directory. On a Makapix board the icon cache
 * lives in PSRAMFS while the default filesystem is LittleFS, which is exactly
 * this situation.
 */
static void testPngImgLoaderUsesGivenFs()
{
    PngImgLoader       loader;
    YAGfxDynamicBitmap bitmap;
    FS                 localFileSystem;
    uint16_t           x;
    uint16_t           y;

    TEST_ASSERT_TRUE(localFileSystem.begin(FS_ROOT_PATH));

    TEST_ASSERT_EQUAL(PngImgLoader::RET_OK, loader.load(localFileSystem, FILE_NAME_IN_FS_ROOT, bitmap));
    TEST_ASSERT_TRUE(bitmap.isAllocated());
    TEST_ASSERT_EQUAL_UINT16(EXPECTED_DATA_WIDTH, bitmap.getWidth());
    TEST_ASSERT_EQUAL_UINT16(EXPECTED_DATA_HEIGHT, bitmap.getHeight());

    /* The content must be the image and not something which the global
     * filesystem happened to deliver.
     */
    for (y = 0U; y < EXPECTED_DATA_HEIGHT; ++y)
    {
        for (x = 0U; x < EXPECTED_DATA_WIDTH; ++x)
        {
            const uint32_t expected = EXPECTED_DATA[x + y * EXPECTED_DATA_WIDTH];
            const uint32_t actual   = static_cast<uint32_t>(bitmap.getColor(static_cast<int16_t>(x), static_cast<int16_t>(y)));

            TEST_ASSERT_EQUAL_UINT32(expected, actual);
        }
    }

    localFileSystem.end();
}

/**
 * Test the PNG image loader with a truecolor PNG image which contains an alpha
 * channel. Transparent pixels must be composited against black and not show
 * the color which is stored underneath them.
 */
static void testPngImgLoaderAlpha()
{
    PngImgLoader       loader;
    YAGfxDynamicBitmap bitmap;
    FS                 fileSystem;
    uint16_t           x;
    uint16_t           y;

    /* 10x10 pixels. The left half is opaque red, the right half is green with
     * alpha 0. The green must never become visible.
     */
    const uint16_t WIDTH           = 10U;
    const uint16_t HEIGHT          = 10U;
    const uint16_t OPAQUE_WIDTH    = 5U;
    const uint32_t COLOR_OPAQUE    = 0xFF0000U;
    const uint32_t COLOR_COMPOSED  = 0x000000U;
    const size_t   BYTES_PER_PIXEL = 4U;
    const size_t   STRIDE          = 1U + WIDTH * BYTES_PER_PIXEL;

    uint8_t        raw[HEIGHT * (1U + WIDTH * BYTES_PER_PIXEL)];
    PngSpec        spec = { WIDTH, HEIGHT, 8U, PNG_COLOR_TYPE_RGBA, nullptr, 0U, nullptr, 0U, raw, sizeof(raw) };

    for (y = 0U; y < HEIGHT; ++y)
    {
        uint8_t* line = &raw[y * STRIDE];

        line[0U]      = 0U; /* Filter type: none. */

        for (x = 0U; x < WIDTH; ++x)
        {
            uint8_t*   pixel    = &line[1U + x * BYTES_PER_PIXEL];
            const bool isOpaque = (OPAQUE_WIDTH > x);

            pixel[0U]           = (true == isOpaque) ? 255U : 0U; /* Red */
            pixel[1U]           = (true == isOpaque) ? 0U : 255U; /* Green */
            pixel[2U]           = 0U;                             /* Blue */
            pixel[3U]           = (true == isOpaque) ? 255U : 0U; /* Alpha */
        }
    }

    TEST_ASSERT_TRUE(writePngFile(FILE_NAME_GENERATED, spec));

    TEST_ASSERT_EQUAL(PngImgLoader::RET_OK, loader.load(fileSystem, FILE_NAME_GENERATED, bitmap));
    TEST_ASSERT_EQUAL_UINT16(WIDTH, bitmap.getWidth());
    TEST_ASSERT_EQUAL_UINT16(HEIGHT, bitmap.getHeight());

    for (y = 0U; y < HEIGHT; ++y)
    {
        for (x = 0U; x < WIDTH; ++x)
        {
            const uint32_t expected = (OPAQUE_WIDTH > x) ? COLOR_OPAQUE : COLOR_COMPOSED;
            const uint32_t actual   = static_cast<uint32_t>(bitmap.getColor(static_cast<int16_t>(x), static_cast<int16_t>(y)));

            TEST_ASSERT_EQUAL_UINT32(expected, actual);
        }
    }

    (void)remove(FILE_NAME_GENERATED);
}

/**
 * Test the PNG image loader with a truncated PNG file. The loader must fail
 * and release the bitmap instead of leaving a half filled one behind.
 */
static void testPngImgLoaderTruncated()
{
    PngImgLoader       loader;
    YAGfxDynamicBitmap bitmap;
    FS                 fileSystem;
    size_t             fullSize = 0U;

    TEST_ASSERT_TRUE(getFileSize(FILE_NAME_STATIC, fullSize));
    TEST_ASSERT_GREATER_THAN_UINT32(0U, fullSize);

    /* Cut the file to the half of its length. The IHDR survives, the image
     * data does not.
     */
    TEST_ASSERT_TRUE(copyFilePart(FILE_NAME_STATIC, FILE_NAME_TRUNCATED, fullSize / 2U));

    TEST_ASSERT_NOT_EQUAL(PngImgLoader::RET_OK, loader.load(fileSystem, FILE_NAME_TRUNCATED, bitmap));
    TEST_ASSERT_FALSE(bitmap.isAllocated());
    TEST_ASSERT_EQUAL_UINT16(0U, bitmap.getWidth());
    TEST_ASSERT_EQUAL_UINT16(0U, bitmap.getHeight());

    (void)remove(FILE_NAME_TRUNCATED);
}

/**
 * Test the PNG image loader with an image whose dimensions can not be
 * represented by the bitmap.
 *
 * The IHDR width and height are 31 bit wide, therefore a 33 byte file is
 * enough to claim an image of billions of pixels. Without the representability
 * guard the narrowing to the bitmap dimensions would silently wrap and a tiny
 * bitmap would be created and reported as success for a huge image.
 *
 * Note, the height is the dimension which reaches the guard. PNGdec refuses
 * every image whose decoded line does not fit into its own line buffer, which
 * happens well below the representable width.
 */
static void testPngImgLoaderImgTooBig()
{
    PngImgLoader       loader;
    YAGfxDynamicBitmap bitmap;
    FS                 fileSystem;

    /* Both wrap to a harmless looking value when narrowed: 65546 & 0xFFFF is
     * 10 and 2147418122 & 0xFFFF is 10 as well. The latter is the largest
     * dimension which the PNG specification still allows, because the IHDR
     * dimensions are 31 bit wide.
     */
    const uint32_t DIM_TOO_BIG     = 65546U;
    const uint32_t DIM_MAX_LEGAL   = 2147418122U;

    /* Out of the PNG specification, because bit 31 is set. */
    const uint32_t DIM_OUT_OF_SPEC = 2147516426U;

    /* Larger than the representable 32767, but small enough to still fit into
     * an unsigned 16 bit value. Narrowing this one to the bitmap dimensions
     * would not even wrap, but every image row beyond 32767 would be dropped
     * silently while the load still reported success.
     */
    const uint32_t DIM_UNREACHABLE = 40000U;

    const uint32_t DIM_SMALL       = 10U;

    PngSpec        specTooBig      = { DIM_SMALL, DIM_TOO_BIG, 8U, PNG_COLOR_TYPE_RGB, nullptr, 0U, nullptr, 0U, nullptr, 0U };
    PngSpec        specMaxLegal    = { DIM_SMALL, DIM_MAX_LEGAL, 8U, PNG_COLOR_TYPE_RGB, nullptr, 0U, nullptr, 0U, nullptr, 0U };
    PngSpec        specOutOfSpec   = { DIM_SMALL, DIM_OUT_OF_SPEC, 8U, PNG_COLOR_TYPE_RGB, nullptr, 0U, nullptr, 0U, nullptr, 0U };
    PngSpec        specUnreachable = { DIM_SMALL, DIM_UNREACHABLE, 8U, PNG_COLOR_TYPE_RGB, nullptr, 0U, nullptr, 0U, nullptr, 0U };
    PngSpec        specTooWide     = { DIM_TOO_BIG, DIM_SMALL, 8U, PNG_COLOR_TYPE_RGB, nullptr, 0U, nullptr, 0U, nullptr, 0U };

    TEST_ASSERT_TRUE(writePngFile(FILE_NAME_GENERATED, specTooBig));
    TEST_ASSERT_EQUAL(PngImgLoader::RET_IMG_TOO_BIG, loader.load(fileSystem, FILE_NAME_GENERATED, bitmap));
    TEST_ASSERT_FALSE(bitmap.isAllocated());

    TEST_ASSERT_TRUE(writePngFile(FILE_NAME_GENERATED, specMaxLegal));
    TEST_ASSERT_EQUAL(PngImgLoader::RET_IMG_TOO_BIG, loader.load(fileSystem, FILE_NAME_GENERATED, bitmap));
    TEST_ASSERT_FALSE(bitmap.isAllocated());

    /* A dimension with bit 31 set is no legal PNG dimension at all. PNGdec
     * reads it as a negative number, which must be refused as an invalid
     * format and never reach the bitmap allocation.
     */
    TEST_ASSERT_TRUE(writePngFile(FILE_NAME_GENERATED, specOutOfSpec));
    TEST_ASSERT_EQUAL(PngImgLoader::RET_FILE_FORMAT_INVALID, loader.load(fileSystem, FILE_NAME_GENERATED, bitmap));
    TEST_ASSERT_FALSE(bitmap.isAllocated());

    TEST_ASSERT_TRUE(writePngFile(FILE_NAME_GENERATED, specUnreachable));
    TEST_ASSERT_EQUAL(PngImgLoader::RET_IMG_TOO_BIG, loader.load(fileSystem, FILE_NAME_GENERATED, bitmap));
    TEST_ASSERT_FALSE(bitmap.isAllocated());

    /* A too wide image is already refused by PNGdec itself, which must end up
     * as the same answer and not as an invalid format.
     */
    TEST_ASSERT_TRUE(writePngFile(FILE_NAME_GENERATED, specTooWide));
    TEST_ASSERT_EQUAL(PngImgLoader::RET_IMG_TOO_BIG, loader.load(fileSystem, FILE_NAME_GENERATED, bitmap));
    TEST_ASSERT_FALSE(bitmap.isAllocated());

    (void)remove(FILE_NAME_GENERATED);
}

/**
 * Test the PNG image loader with the pixel types which the static fixture does
 * not cover: grayscale, grayscale with alpha and indexed with and without a
 * transparency chunk.
 */
static void testPngImgLoaderPixelTypes()
{
    PngImgLoader       loader;
    YAGfxDynamicBitmap bitmap;
    FS                 fileSystem;

    /* Grayscale, 4 pixels in one line. */
    const uint8_t rawGray[]    = { 0U, 0x00U, 0x55U, 0xAAU, 0xFFU };
    PngSpec       specGray     = { 4U, 1U, 8U, PNG_COLOR_TYPE_GRAY, nullptr, 0U, nullptr, 0U, rawGray, sizeof(rawGray) };

    /* Grayscale with alpha, 2 pixels in one line. The 2nd one is transparent. */
    const uint8_t rawGrayA[]   = { 0U, 0xC8U, 0xFFU, 0xC8U, 0x00U };
    PngSpec       specGrayA    = { 2U, 1U, 8U, PNG_COLOR_TYPE_GRAY_A, nullptr, 0U, nullptr, 0U, rawGrayA, sizeof(rawGrayA) };

    /* Indexed, 2 pixels in one line. */
    const uint8_t palette[]    = { 0xFFU, 0x00U, 0x00U, 0x00U, 0xFFU, 0x00U };
    const uint8_t rawIndexed[] = { 0U, 0x00U, 0x01U };
    PngSpec       specIndexed  = { 2U, 1U, 8U, PNG_COLOR_TYPE_INDEXED, palette, sizeof(palette), nullptr, 0U, rawIndexed, sizeof(rawIndexed) };

    /* Indexed with transparency, 2 pixels in one line. The 2nd one is
     * transparent and must not show its green palette color.
     */
    const uint8_t trns[]       = { 0xFFU, 0x00U };
    PngSpec       specIndexedA = { 2U, 1U, 8U, PNG_COLOR_TYPE_INDEXED, palette, sizeof(palette), trns, sizeof(trns), rawIndexed, sizeof(rawIndexed) };

    TEST_ASSERT_TRUE(writePngFile(FILE_NAME_GENERATED, specGray));
    TEST_ASSERT_EQUAL(PngImgLoader::RET_OK, loader.load(fileSystem, FILE_NAME_GENERATED, bitmap));
    TEST_ASSERT_EQUAL_UINT16(4U, bitmap.getWidth());
    TEST_ASSERT_EQUAL_UINT32(0x000000U, static_cast<uint32_t>(bitmap.getColor(0, 0)));
    TEST_ASSERT_EQUAL_UINT32(0x555555U, static_cast<uint32_t>(bitmap.getColor(1, 0)));
    TEST_ASSERT_EQUAL_UINT32(0xAAAAAAU, static_cast<uint32_t>(bitmap.getColor(2, 0)));
    TEST_ASSERT_EQUAL_UINT32(0xFFFFFFU, static_cast<uint32_t>(bitmap.getColor(3, 0)));

    bitmap.release();
    TEST_ASSERT_TRUE(writePngFile(FILE_NAME_GENERATED, specGrayA));
    TEST_ASSERT_EQUAL(PngImgLoader::RET_OK, loader.load(fileSystem, FILE_NAME_GENERATED, bitmap));
    TEST_ASSERT_EQUAL_UINT16(2U, bitmap.getWidth());
    TEST_ASSERT_EQUAL_UINT32(0xC8C8C8U, static_cast<uint32_t>(bitmap.getColor(0, 0)));
    TEST_ASSERT_EQUAL_UINT32(0x000000U, static_cast<uint32_t>(bitmap.getColor(1, 0)));

    bitmap.release();
    TEST_ASSERT_TRUE(writePngFile(FILE_NAME_GENERATED, specIndexed));
    TEST_ASSERT_EQUAL(PngImgLoader::RET_OK, loader.load(fileSystem, FILE_NAME_GENERATED, bitmap));
    TEST_ASSERT_EQUAL_UINT16(2U, bitmap.getWidth());
    TEST_ASSERT_EQUAL_UINT32(0xFF0000U, static_cast<uint32_t>(bitmap.getColor(0, 0)));
    TEST_ASSERT_EQUAL_UINT32(0x00FF00U, static_cast<uint32_t>(bitmap.getColor(1, 0)));

    bitmap.release();
    TEST_ASSERT_TRUE(writePngFile(FILE_NAME_GENERATED, specIndexedA));
    TEST_ASSERT_EQUAL(PngImgLoader::RET_OK, loader.load(fileSystem, FILE_NAME_GENERATED, bitmap));
    TEST_ASSERT_EQUAL_UINT16(2U, bitmap.getWidth());
    TEST_ASSERT_EQUAL_UINT32(0xFF0000U, static_cast<uint32_t>(bitmap.getColor(0, 0)));
    TEST_ASSERT_EQUAL_UINT32(0x000000U, static_cast<uint32_t>(bitmap.getColor(1, 0)));

    (void)remove(FILE_NAME_GENERATED);
}

/**
 * Test the PNG image loader with indexed images whose samples are packed
 * several to a byte. A 4 bit palette is the usual shape of a small icon.
 *
 * The samples are palette indices, therefore unpacking them is a shift and a
 * mask and the values are never scaled.
 *
 * The 4 bit case is 7 pixels wide on purpose: a row is then
 * (7 + 1) / 2 == 4 bytes whose last byte carries one sample and one padding
 * nibble, and it has 2 rows, so a wrong row stride can not hide.
 */
static void testPngImgLoaderPackedIndexed()
{
    PngImgLoader       loader;
    YAGfxDynamicBitmap bitmap;
    FS                 fileSystem;
    uint16_t           x;

    const uint32_t     RED         = 0xFF0000U;
    const uint32_t     GREEN       = 0x00FF00U;
    const uint32_t     BLUE        = 0x0000FFU;
    const uint32_t     WHITE       = 0xFFFFFFU;

    /* 4 bit, 7x2 pixels, 3 palette colors.
     * Row 0 indices: 0 1 2 0 1 2 0  -> 0x01 0x20 0x12 0x0_
     * Row 1 indices: 2 1 0 2 1 0 2  -> 0x21 0x02 0x10 0x2_
     */
    /* clang-format off */
    const uint8_t  palette3[] = {
        0xFFU, 0x00U, 0x00U, /* 0: red */
        0x00U, 0xFFU, 0x00U, /* 1: green */
        0x00U, 0x00U, 0xFFU  /* 2: blue */
    };
    const uint8_t  raw4[] = {
        0U, 0x01U, 0x20U, 0x12U, 0x00U, /* Row 0 */
        0U, 0x21U, 0x02U, 0x10U, 0x20U  /* Row 1 */
    };
    /* clang-format on */
    PngSpec        spec4           = { 7U, 2U, 4U, PNG_COLOR_TYPE_INDEXED, palette3, sizeof(palette3), nullptr, 0U, raw4, sizeof(raw4) };
    const uint32_t expected4Row0[] = { RED, GREEN, BLUE, RED, GREEN, BLUE, RED };
    const uint32_t expected4Row1[] = { BLUE, GREEN, RED, BLUE, GREEN, RED, BLUE };

    /* 2 bit, 5x1 pixels, 4 palette colors.
     * Indices: 0 1 2 3 0 -> 0b00011011 0b00______ -> 0x1B 0x00
     */
    /* clang-format off */
    const uint8_t  palette4[] = {
        0xFFU, 0x00U, 0x00U, /* 0: red */
        0x00U, 0xFFU, 0x00U, /* 1: green */
        0x00U, 0x00U, 0xFFU, /* 2: blue */
        0xFFU, 0xFFU, 0xFFU  /* 3: white */
    };
    /* clang-format on */
    const uint8_t  raw2[]          = { 0U, 0x1BU, 0x00U };
    PngSpec        spec2           = { 5U, 1U, 2U, PNG_COLOR_TYPE_INDEXED, palette4, sizeof(palette4), nullptr, 0U, raw2, sizeof(raw2) };
    const uint32_t expected2[]     = { RED, GREEN, BLUE, WHITE, RED };

    /* 1 bit, 3x1 pixels, 2 palette colors.
     * Indices: 1 0 1 -> 0b101_____ -> 0xA0
     */
    /* clang-format off */
    const uint8_t  palette2[] = {
        0xFFU, 0x00U, 0x00U, /* 0: red */
        0x00U, 0x00U, 0xFFU  /* 1: blue */
    };
    /* clang-format on */
    const uint8_t  raw1[]          = { 0U, 0xA0U };
    PngSpec        spec1           = { 3U, 1U, 1U, PNG_COLOR_TYPE_INDEXED, palette2, sizeof(palette2), nullptr, 0U, raw1, sizeof(raw1) };
    const uint32_t expected1[]     = { BLUE, RED, BLUE };

    TEST_ASSERT_TRUE(writePngFile(FILE_NAME_GENERATED, spec4));
    TEST_ASSERT_EQUAL(PngImgLoader::RET_OK, loader.load(fileSystem, FILE_NAME_GENERATED, bitmap));
    TEST_ASSERT_EQUAL_UINT16(7U, bitmap.getWidth());
    TEST_ASSERT_EQUAL_UINT16(2U, bitmap.getHeight());

    for (x = 0U; x < 7U; ++x)
    {
        TEST_ASSERT_EQUAL_UINT32(expected4Row0[x], static_cast<uint32_t>(bitmap.getColor(static_cast<int16_t>(x), 0)));
        TEST_ASSERT_EQUAL_UINT32(expected4Row1[x], static_cast<uint32_t>(bitmap.getColor(static_cast<int16_t>(x), 1)));
    }

    bitmap.release();
    TEST_ASSERT_TRUE(writePngFile(FILE_NAME_GENERATED, spec2));
    TEST_ASSERT_EQUAL(PngImgLoader::RET_OK, loader.load(fileSystem, FILE_NAME_GENERATED, bitmap));
    TEST_ASSERT_EQUAL_UINT16(5U, bitmap.getWidth());

    for (x = 0U; x < 5U; ++x)
    {
        TEST_ASSERT_EQUAL_UINT32(expected2[x], static_cast<uint32_t>(bitmap.getColor(static_cast<int16_t>(x), 0)));
    }

    bitmap.release();
    TEST_ASSERT_TRUE(writePngFile(FILE_NAME_GENERATED, spec1));
    TEST_ASSERT_EQUAL(PngImgLoader::RET_OK, loader.load(fileSystem, FILE_NAME_GENERATED, bitmap));
    TEST_ASSERT_EQUAL_UINT16(3U, bitmap.getWidth());

    for (x = 0U; x < 3U; ++x)
    {
        TEST_ASSERT_EQUAL_UINT32(expected1[x], static_cast<uint32_t>(bitmap.getColor(static_cast<int16_t>(x), 0)));
    }

    (void)remove(FILE_NAME_GENERATED);
}

/**
 * Test the PNG image loader with grayscale images whose samples are packed
 * several to a byte.
 *
 * Here the sample is the brightness itself, so it must be stretched to the
 * full 8 bit range. The brightest sample of a 4 bit image is 15 and has to
 * become 255, not the 240 a plain shift by 4 would give.
 */
static void testPngImgLoaderPackedGrayscale()
{
    PngImgLoader       loader;
    YAGfxDynamicBitmap bitmap;
    FS                 fileSystem;
    uint16_t           x;

    /* 4 bit, 4x1 pixels. Samples 0, 5, 10, 15 -> 0x05 0xAF */
    const uint8_t  raw4[]      = { 0U, 0x05U, 0xAFU };
    PngSpec        spec4       = { 4U, 1U, 4U, PNG_COLOR_TYPE_GRAY, nullptr, 0U, nullptr, 0U, raw4, sizeof(raw4) };
    const uint32_t expected4[] = { 0x000000U, 0x555555U, 0xAAAAAAU, 0xFFFFFFU };

    /* 2 bit, 4x1 pixels. Samples 0, 1, 2, 3 -> 0b00011011 -> 0x1B */
    const uint8_t  raw2[]      = { 0U, 0x1BU };
    PngSpec        spec2       = { 4U, 1U, 2U, PNG_COLOR_TYPE_GRAY, nullptr, 0U, nullptr, 0U, raw2, sizeof(raw2) };
    const uint32_t expected2[] = { 0x000000U, 0x555555U, 0xAAAAAAU, 0xFFFFFFU };

    /* 1 bit, 3x1 pixels. Samples 1, 0, 1 -> 0b101_____ -> 0xA0 */
    const uint8_t  raw1[]      = { 0U, 0xA0U };
    PngSpec        spec1       = { 3U, 1U, 1U, PNG_COLOR_TYPE_GRAY, nullptr, 0U, nullptr, 0U, raw1, sizeof(raw1) };
    const uint32_t expected1[] = { 0xFFFFFFU, 0x000000U, 0xFFFFFFU };

    TEST_ASSERT_TRUE(writePngFile(FILE_NAME_GENERATED, spec4));
    TEST_ASSERT_EQUAL(PngImgLoader::RET_OK, loader.load(fileSystem, FILE_NAME_GENERATED, bitmap));
    TEST_ASSERT_EQUAL_UINT16(4U, bitmap.getWidth());

    for (x = 0U; x < 4U; ++x)
    {
        TEST_ASSERT_EQUAL_UINT32(expected4[x], static_cast<uint32_t>(bitmap.getColor(static_cast<int16_t>(x), 0)));
    }

    bitmap.release();
    TEST_ASSERT_TRUE(writePngFile(FILE_NAME_GENERATED, spec2));
    TEST_ASSERT_EQUAL(PngImgLoader::RET_OK, loader.load(fileSystem, FILE_NAME_GENERATED, bitmap));
    TEST_ASSERT_EQUAL_UINT16(4U, bitmap.getWidth());

    for (x = 0U; x < 4U; ++x)
    {
        TEST_ASSERT_EQUAL_UINT32(expected2[x], static_cast<uint32_t>(bitmap.getColor(static_cast<int16_t>(x), 0)));
    }

    bitmap.release();
    TEST_ASSERT_TRUE(writePngFile(FILE_NAME_GENERATED, spec1));
    TEST_ASSERT_EQUAL(PngImgLoader::RET_OK, loader.load(fileSystem, FILE_NAME_GENERATED, bitmap));
    TEST_ASSERT_EQUAL_UINT16(3U, bitmap.getWidth());

    for (x = 0U; x < 3U; ++x)
    {
        TEST_ASSERT_EQUAL_UINT32(expected1[x], static_cast<uint32_t>(bitmap.getColor(static_cast<int16_t>(x), 0)));
    }

    (void)remove(FILE_NAME_GENERATED);
}

/**
 * Test the PNG image loader with an image of 16 bit per sample.
 *
 * PNGdec refuses it in PNGParseInfo() with PNG_UNSUPPORTED_FEATURE and never
 * hands such a line to the draw callback, so it never reaches the loader
 * narrowed to 8 bit. The loader must report that as an unsupported format and
 * not as a broken file.
 */
static void testPngImgLoaderSample16Bit()
{
    PngImgLoader       loader;
    YAGfxDynamicBitmap bitmap;
    FS                 fileSystem;

    /* 16 bit grayscale, 2x1 pixels. */
    const uint8_t raw[] = { 0U, 0x00U, 0x00U, 0xFFU, 0xFFU };
    PngSpec       spec  = { 2U, 1U, 16U, PNG_COLOR_TYPE_GRAY, nullptr, 0U, nullptr, 0U, raw, sizeof(raw) };

    TEST_ASSERT_TRUE(writePngFile(FILE_NAME_GENERATED, spec));
    TEST_ASSERT_EQUAL(PngImgLoader::RET_FILE_FORMAT_UNSUPPORTED, loader.load(fileSystem, FILE_NAME_GENERATED, bitmap));
    TEST_ASSERT_FALSE(bitmap.isAllocated());

    (void)remove(FILE_NAME_GENERATED);
}

/**
 * Test the PNG image loader at the limit of the decoder's internal line
 * buffer.
 *
 * PNGdec keeps the current and the previous de-filtered image line in one
 * buffer of PNG_MAX_BUFFERED_PIXELS (2562) bytes, but only refuses a line of
 * 2562 bytes or more, which is nearly twice what fits. An image between the
 * two writes past the buffer. The loader therefore refuses anything whose
 * line exceeds (2562 - 32) / 2 == 1265 bytes, before decode() is called.
 *
 * Both sides of the boundary are checked for two pixel types: one which trips
 * early, truecolor with alpha at 4 bytes per pixel, and one which trips late,
 * 8 bit indexed at 1 byte per pixel.
 *
 * The images beyond the limit deliberately carry no image data at all. The
 * loader rejects them from their header, so even a regression of the limit
 * could not make this test run the overflowing path.
 */
static void testPngImgLoaderLineBufferLimit()
{
    PngImgLoader       loader;
    YAGfxDynamicBitmap bitmap;
    FS                 fileSystem;
    uint16_t           x;
    uint8_t            raw[1U + 1266U * 4U];

    /* Truecolor with alpha: 4 bytes per pixel, so the last width which fits
     * is 1265 / 4 == 316.
     */
    const uint16_t RGBA_WIDTH_OK      = 316U;
    const uint16_t RGBA_WIDTH_TOO_BIG = 317U;

    /* Indexed with 8 bit samples: 1 byte per pixel. */
    const uint16_t IDX_WIDTH_OK       = 1265U;
    const uint16_t IDX_WIDTH_TOO_BIG  = 1266U;

    /* clang-format off */
    const uint8_t      palette[] = {
        0xFFU, 0x00U, 0x00U, /* 0: red */
        0x00U, 0x00U, 0xFFU  /* 1: blue */
    };
    /* clang-format on */

    PngSpec spec;

    /* Just below the limit, truecolor with alpha. Every pixel opaque red. */
    raw[0U] = 0U; /* Filter type: none. */

    for (x = 0U; x < RGBA_WIDTH_OK; ++x)
    {
        uint8_t* pixel = &raw[1U + x * 4U];

        pixel[0U]      = 0xFFU;
        pixel[1U]      = 0x00U;
        pixel[2U]      = 0x00U;
        pixel[3U]      = 0xFFU;
    }

    spec = { RGBA_WIDTH_OK, 1U, 8U, PNG_COLOR_TYPE_RGBA, nullptr, 0U, nullptr, 0U, raw, 1U + RGBA_WIDTH_OK * 4U };

    TEST_ASSERT_TRUE(writePngFile(FILE_NAME_GENERATED, spec));
    TEST_ASSERT_EQUAL(PngImgLoader::RET_OK, loader.load(fileSystem, FILE_NAME_GENERATED, bitmap));
    TEST_ASSERT_EQUAL_UINT16(RGBA_WIDTH_OK, bitmap.getWidth());
    TEST_ASSERT_EQUAL_UINT32(0xFF0000U, static_cast<uint32_t>(bitmap.getColor(0, 0)));
    TEST_ASSERT_EQUAL_UINT32(0xFF0000U, static_cast<uint32_t>(bitmap.getColor(static_cast<int16_t>(RGBA_WIDTH_OK - 1U), 0)));

    /* One pixel wider, no image data. */
    bitmap.release();
    spec = { RGBA_WIDTH_TOO_BIG, 1U, 8U, PNG_COLOR_TYPE_RGBA, nullptr, 0U, nullptr, 0U, nullptr, 0U };

    TEST_ASSERT_TRUE(writePngFile(FILE_NAME_GENERATED, spec));
    TEST_ASSERT_EQUAL(PngImgLoader::RET_IMG_TOO_BIG, loader.load(fileSystem, FILE_NAME_GENERATED, bitmap));
    TEST_ASSERT_FALSE(bitmap.isAllocated());

    /* Just below the limit, 8 bit indexed. The indices alternate, so an
     * off-by-one in the line length would show up as the wrong color.
     */
    raw[0U] = 0U;

    for (x = 0U; x < IDX_WIDTH_OK; ++x)
    {
        raw[1U + x] = static_cast<uint8_t>(x & 0x01U);
    }

    spec = { IDX_WIDTH_OK, 1U, 8U, PNG_COLOR_TYPE_INDEXED, palette, sizeof(palette), nullptr, 0U, raw, 1U + IDX_WIDTH_OK };

    TEST_ASSERT_TRUE(writePngFile(FILE_NAME_GENERATED, spec));
    TEST_ASSERT_EQUAL(PngImgLoader::RET_OK, loader.load(fileSystem, FILE_NAME_GENERATED, bitmap));
    TEST_ASSERT_EQUAL_UINT16(IDX_WIDTH_OK, bitmap.getWidth());
    TEST_ASSERT_EQUAL_UINT32(0xFF0000U, static_cast<uint32_t>(bitmap.getColor(0, 0)));
    TEST_ASSERT_EQUAL_UINT32(0x0000FFU, static_cast<uint32_t>(bitmap.getColor(1, 0)));
    TEST_ASSERT_EQUAL_UINT32(0xFF0000U, static_cast<uint32_t>(bitmap.getColor(static_cast<int16_t>(IDX_WIDTH_OK - 1U), 0)));

    /* One pixel wider, no image data. */
    bitmap.release();
    spec = { IDX_WIDTH_TOO_BIG, 1U, 8U, PNG_COLOR_TYPE_INDEXED, palette, sizeof(palette), nullptr, 0U, nullptr, 0U };

    TEST_ASSERT_TRUE(writePngFile(FILE_NAME_GENERATED, spec));
    TEST_ASSERT_EQUAL(PngImgLoader::RET_IMG_TOO_BIG, loader.load(fileSystem, FILE_NAME_GENERATED, bitmap));
    TEST_ASSERT_FALSE(bitmap.isAllocated());

    (void)remove(FILE_NAME_GENERATED);
}

/**
 * Copy at most the given number of bytes from one file to another one.
 *
 * @param[in] srcFileName   Name of the source file.
 * @param[in] dstFileName   Name of the destination file.
 * @param[in] maxSize       Max. number of bytes to copy.
 *
 * @return If successful, it will return true otherwise false.
 */
static bool copyFilePart(const char* srcFileName, const char* dstFileName, size_t maxSize)
{
    bool  isSuccessful = false;
    FILE* src          = fopen(srcFileName, "rb");

    if (nullptr != src)
    {
        FILE* dst = fopen(dstFileName, "wb");

        if (nullptr != dst)
        {
            size_t  remaining = maxSize;
            uint8_t buffer[64U];

            isSuccessful = true;

            while ((0U < remaining) && (true == isSuccessful))
            {
                const size_t chunkSize = (sizeof(buffer) < remaining) ? sizeof(buffer) : remaining;
                const size_t readSize  = fread(buffer, 1U, chunkSize, src);

                if ((0U == readSize) ||
                    (readSize != fwrite(buffer, 1U, readSize, dst)))
                {
                    isSuccessful = false;
                }
                else
                {
                    remaining -= readSize;
                }
            }

            (void)fclose(dst);
        }

        (void)fclose(src);
    }

    return isSuccessful;
}

/**
 * Get the size of a file in bytes.
 *
 * @param[in] fileName  Name of the file.
 * @param[out] size     Size of the file in bytes.
 *
 * @return If successful, it will return true otherwise false.
 */
static bool getFileSize(const char* fileName, size_t& size)
{
    bool  isSuccessful = false;
    FILE* fd           = fopen(fileName, "rb");

    if (nullptr != fd)
    {
        if (0 == fseek(fd, 0, SEEK_END))
        {
            const long pos = ftell(fd);

            if (0 < pos)
            {
                size         = static_cast<size_t>(pos);
                isSuccessful = true;
            }
        }

        (void)fclose(fd);
    }

    return isSuccessful;
}

/**
 * Write the given bytes to a file, replacing any existing one.
 *
 * @param[in] fileName  Name of the destination file.
 * @param[in] data      Bytes to write. Must not be nullptr.
 * @param[in] size      Number of bytes to write.
 *
 * @return If successful, it will return true otherwise false.
 */
static bool writeFile(const char* fileName, const uint8_t* data, size_t size)
{
    bool  isSuccessful = false;
    FILE* fd           = fopen(fileName, "wb");

    if (nullptr != fd)
    {
        if (size == fwrite(data, 1U, size, fd))
        {
            isSuccessful = true;
        }

        (void)fclose(fd);
    }

    return isSuccessful;
}

/**
 * Write a PNG file according to the given specification.
 *
 * The image data is deflated with stored blocks only, which keeps the test
 * free of any compressor and is still a valid zlib stream.
 *
 * @param[in] fileName  Name of the destination file.
 * @param[in] spec      Specification of the PNG file.
 *
 * @return If successful, it will return true otherwise false.
 */
static bool writePngFile(const char* fileName, const PngSpec& spec)
{
    bool    isSuccessful = true;
    uint8_t buffer[PNG_BUFFER_SIZE];
    uint8_t ihdr[PNG_IHDR_PAYLOAD_SIZE];
    size_t  offset = sizeof(PNG_SIGNATURE);

    memcpy(buffer, PNG_SIGNATURE, sizeof(PNG_SIGNATURE));

    writeUInt32Be(&ihdr[0U], spec.width);
    writeUInt32Be(&ihdr[4U], spec.height);
    ihdr[8U]  = spec.bitDepth;
    ihdr[9U]  = spec.colorType;
    ihdr[10U] = 0U; /* Compression method: deflate. */
    ihdr[11U] = 0U; /* Filter method: adaptive. */
    ihdr[12U] = 0U; /* Interlace method: none. */

    if (false == appendChunk(buffer, sizeof(buffer), offset, "IHDR", ihdr, sizeof(ihdr)))
    {
        isSuccessful = false;
    }

    if ((true == isSuccessful) &&
        (nullptr != spec.palette))
    {
        isSuccessful = appendChunk(buffer, sizeof(buffer), offset, "PLTE", spec.palette, spec.paletteSize);
    }

    if ((true == isSuccessful) &&
        (nullptr != spec.trns))
    {
        isSuccessful = appendChunk(buffer, sizeof(buffer), offset, "tRNS", spec.trns, spec.trnsSize);
    }

    if ((true == isSuccessful) &&
        (nullptr != spec.raw))
    {
        isSuccessful = appendIdatChunk(buffer, sizeof(buffer), offset, spec.raw, spec.rawSize);
    }

    if (true == isSuccessful)
    {
        isSuccessful = appendChunk(buffer, sizeof(buffer), offset, "IEND", nullptr, 0U);
    }

    if (true == isSuccessful)
    {
        isSuccessful = writeFile(fileName, buffer, offset);
    }

    return isSuccessful;
}

/**
 * Append a PNG chunk, consisting of its length, type, payload and CRC.
 *
 * @param[in] buffer        Destination buffer.
 * @param[in] bufferSize    Size of the destination buffer in bytes.
 * @param[in,out] offset    Current write position in the destination buffer.
 * @param[in] type          Chunk type, 4 characters.
 * @param[in] payload       Chunk payload. May be nullptr for an empty chunk.
 * @param[in] payloadSize   Size of the chunk payload in bytes.
 *
 * @return If successful, it will return true otherwise false.
 */
static bool appendChunk(uint8_t* buffer, size_t bufferSize, size_t& offset, const char* type, const uint8_t* payload, size_t payloadSize)
{
    bool         isSuccessful = false;
    const size_t chunkSize    = PNG_CHUNK_OVERHEAD + payloadSize;

    if (bufferSize >= (offset + chunkSize))
    {
        uint8_t* chunk = &buffer[offset];

        writeUInt32Be(&chunk[0U], static_cast<uint32_t>(payloadSize));
        memcpy(&chunk[4U], type, 4U);

        if (0U < payloadSize)
        {
            memcpy(&chunk[8U], payload, payloadSize);
        }

        /* The CRC covers the chunk type and the chunk payload. */
        writeUInt32Be(&chunk[8U + payloadSize], calcCrc32(&chunk[4U], 4U + payloadSize));

        offset       += chunkSize;
        isSuccessful  = true;
    }

    return isSuccessful;
}

/**
 * Append an IDAT chunk, which carries the raw image data as a zlib stream
 * built from stored deflate blocks.
 *
 * @param[in] buffer        Destination buffer.
 * @param[in] bufferSize    Size of the destination buffer in bytes.
 * @param[in,out] offset    Current write position in the destination buffer.
 * @param[in] raw           Raw image data. Must not be nullptr.
 * @param[in] rawSize       Size of the raw image data in bytes.
 *
 * @return If successful, it will return true otherwise false.
 */
static bool appendIdatChunk(uint8_t* buffer, size_t bufferSize, size_t& offset, const uint8_t* raw, size_t rawSize)
{
    bool         isSuccessful = false;
    uint8_t      zlibStream[PNG_BUFFER_SIZE];
    const size_t zlibSize = 2U + 5U + rawSize + 4U;

    /* One stored block is enough, because the test images are small. */
    if ((sizeof(zlibStream) >= zlibSize) &&
        (0xFFFFU >= rawSize))
    {
        const uint32_t adler = calcAdler32(raw, rawSize);

        zlibStream[0U]       = 0x78U; /* Deflate, 32 kByte window. */
        zlibStream[1U]       = 0x01U; /* No preset dictionary, fastest level. */
        zlibStream[2U]       = 0x01U; /* Final block, stored. */
        zlibStream[3U]       = static_cast<uint8_t>(rawSize & 0xFFU);
        zlibStream[4U]       = static_cast<uint8_t>((rawSize >> 8U) & 0xFFU);
        zlibStream[5U]       = static_cast<uint8_t>((~rawSize) & 0xFFU);
        zlibStream[6U]       = static_cast<uint8_t>(((~rawSize) >> 8U) & 0xFFU);

        memcpy(&zlibStream[7U], raw, rawSize);
        writeUInt32Be(&zlibStream[7U + rawSize], adler);

        isSuccessful = appendChunk(buffer, bufferSize, offset, "IDAT", zlibStream, zlibSize);
    }

    return isSuccessful;
}

/**
 * Write a 32 bit value in network byte order.
 *
 * @param[out] buffer   Destination buffer, at least 4 bytes.
 * @param[in] value     Value to write.
 */
static void writeUInt32Be(uint8_t* buffer, uint32_t value)
{
    buffer[0U] = static_cast<uint8_t>((value >> 24U) & 0xFFU);
    buffer[1U] = static_cast<uint8_t>((value >> 16U) & 0xFFU);
    buffer[2U] = static_cast<uint8_t>((value >> 8U) & 0xFFU);
    buffer[3U] = static_cast<uint8_t>(value & 0xFFU);
}

/**
 * Calculate the CRC-32 checksum which PNG uses for its chunks.
 *
 * @param[in] data  Data to calculate the checksum of. Must not be nullptr.
 * @param[in] size  Size of the data in bytes.
 *
 * @return CRC-32 checksum
 */
static uint32_t calcCrc32(const uint8_t* data, size_t size)
{
    uint32_t crc = 0xFFFFFFFFU;
    size_t   idx;

    /* Reversed representation of the CRC-32 polynomial. */
    const uint32_t POLYNOMIAL = 0xEDB88320U;

    for (idx = 0U; idx < size; ++idx)
    {
        uint8_t bit;

        crc ^= static_cast<uint32_t>(data[idx]);

        for (bit = 0U; bit < 8U; ++bit)
        {
            if (0U != (crc & 1U))
            {
                crc = (crc >> 1U) ^ POLYNOMIAL;
            }
            else
            {
                crc >>= 1U;
            }
        }
    }

    return crc ^ 0xFFFFFFFFU;
}

/**
 * Calculate the Adler-32 checksum which the zlib stream is terminated with.
 *
 * @param[in] data  Data to calculate the checksum of. Must not be nullptr.
 * @param[in] size  Size of the data in bytes.
 *
 * @return Adler-32 checksum
 */
static uint32_t calcAdler32(const uint8_t* data, size_t size)
{
    uint32_t sumLow  = 1U;
    uint32_t sumHigh = 0U;
    size_t   idx;

    /* Largest prime which is smaller than 65536. */
    const uint32_t MODULO = 65521U;

    for (idx = 0U; idx < size; ++idx)
    {
        sumLow  = (sumLow + static_cast<uint32_t>(data[idx])) % MODULO;
        sumHigh = (sumHigh + sumLow) % MODULO;
    }

    return (sumHigh << 16U) | sumLow;
}
